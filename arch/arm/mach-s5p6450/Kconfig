## arch/arm/mach-s5p6450/Kconfig
```kconfig
# arch/arm/mach-s5p6450/Kconfig
#
# Copyright (c) 2009 Samsung Electronics Co., Ltd.
#		http://www.samsung.com/
#
# Licensed under GPLv2

if ARCH_S5P6450

config CPU_S5P6450
	bool
	select S3C_PL330_DMA
	select S3C_DEV_RTC
	help
	  Enable S5P6450 CPU support

config MACH_SMDK6450
	bool "SMDK6450"
	select CPU_S5P6450
	select S3C_DEV_MSHC
	select S3C_DEV_HSMMC
	select S3C_DEV_HSMMC1
	select S5P6450_SETUP_SDHCI
	select S5P6450_SETUP_SDHCI_GPIO
	select SAMSUNG_DEV_ADC
	select SAMSUNG_DEV_TS
        select S3C_DEV_GIB
	select S3C_DEV_WDT
	select SAMSUNG_WAKEMASK
	help
	  Machine support for the Samsung SMDK6450

config S5P6450_SETUP_FB_S3C
	bool
	default y
	help
	  Common setup code for S5P6450 with a LCD display helper

config S5P6450_SETUP_SDHCI
	bool
	select S5P6450_SETUP_SDHCI_GPIO
	help
	  Internal helper functions for S5P6450 based SDHCI systems.

config S5P6450_SETUP_SDHCI_GPIO
	bool
	help
	  Common setup code for SDHCI gpio.

config S5P6450_SETUP_I2C1
	bool
	default y
	help
	  Common setup code for i2c bus 1.
endif
```

## arch/arm/mach-s5pv310/Kconfig
```kconfig
# arch/arm/mach-s5pv310/Kconfig
#
# Copyright (c) 2010 Samsung Electronics Co., Ltd.
#		http://www.samsung.com/
#
# Licensed under GPLv2

# Configuration options for the S5PV310

if ARCH_S5PV310

config CPU_S5PV310
	bool
	select PLAT_S5P
	select S3C_PL330_DMA
	select S3C_DEV_RTC
	help
	  Enable S5PV310 CPU support

config S5PV310_SETUP_I2C1
	bool
	default y
	help
	  Common setup code for i2c bus 1.

config S5PV310_SETUP_FB_S3C
	bool
	default y
	help
	  Setup code for S5PV310 FIMD

config S5PV310_SETUP_FIMC0
	bool
	depends on VIDEO_FIMC
	default y
	help
	  Common setup code for FIMC controller 0.

config S5PV310_SETUP_FIMC1
	bool
	depends on VIDEO_FIMC
	default y
	help
	  Common setup code for FIMC controller 1.

config S5PV310_SETUP_FIMC2
	bool
	depends on VIDEO_FIMC
	default y
	help
	  Common setup code for FIMC controller 2.

config S5PV310_SETUP_FIMC3
	bool
	depends on VIDEO_FIMC
	default y
	help
	  Common setup code for FIMC controller 3.

config S5PV310_SETUP_CSIS
	bool
	depends on VIDEO_FIMC_MIPI
	default y
	help
	  Common setup code for MIPI-CSIS

config S5PV310_SETUP_I2C2
	bool
	default y
	help
	  Common setup code for i2c bus 2.

config S5PV310_SETUP_I2C3
	bool
	default y
	help
	  Common setup code for i2c bus 3.

config S5PV310_SETUP_I2C4
	bool
	default y
	help
	  Common setup code for i2c bus 4.

config S5PV310_SETUP_I2C5
	bool
	default y
	help
	  Common setup code for i2c bus 5.

config S5PV310_SETUP_I2C6
	bool
	default y
	help
	  Common setup code for i2c bus 6.

config S5PV310_SETUP_I2C7
	bool
	default y
	help
	  Common setup code for i2c bus 7.

config S5PV310_SETUP_SDHCI
	bool
	select S5PV310_SETUP_SDHCI_GPIO
	help
	  Internal helper functions for S5PV310 based SDHCI systems.

config S5PV310_SETUP_SDHCI_GPIO
	bool
	help
	  Common setup code for SDHCI gpio.

# machine support

config MACH_SMDKV310
	bool "SMDKV310"
	select CPU_S5PV310
	select ARCH_SPARSEMEM_ENABLE
	select SAMSUNG_DEV_ADC
	select SAMSUNG_DEV_TS
	select S3C_DEV_WDT
	select HAVE_S3C2410_WATCHDOG
	select HAVE_PWM
	select S3C_DEV_HSMMC
	select S3C_DEV_HSMMC2
	select S5PV310_SETUP_SDHCI
	select S3C_DEV_GIB
	help
	  Machine support for Samsung SMDKV310

config S5PV310_FPGA
	bool "FPGA"
endif
```

## drivers/gib/Kconfig
```kconfig
#
# GIB driver configuration
#

menu "GIB support"

config GIB
	bool "GIB support"
	help
	  The "Serial Peripheral Interface" is a low level synchronous
	  protocol.  Chips that support GIB can have data transfer rates
	  up to several tens of Mbit/sec.  Chips are addressed with a
	  controller and a chipselect.  Most GIB slaves don't support
	  dynamic device discovery; some are even write-only or read-only.

	  GIB is widely used by microcontrollers to talk with sensors,
	  eeprom and flash memory, codecs and various other controller
	  chips, analog to digital (and d-to-a) converters, and more.
	  MMC and SD cards can be accessed using GIB protocol; and for
	  DataFlash cards used in MMC sockets, GIB must always be used.

	  GIB is one of a family of similar protocols using a four wire
	  interface (select, clock, data in, data out) including Microwire
	  (half duplex), SSP, SSI, and PSP.  This driver framework should
	  work with most such devices and controllers.

config GIB_DEBUG
	boolean "Debug support for GIB drivers"
	depends on GIB && DEBUG_KERNEL
	help
	  Say "yes" to enable debug messaging (like dev_dbg and pr_debug),
	  sysfs, and debugfs support in GIB controller and protocol drivers.

#
# MASTER side ... talking to discrete GIB slave chips including microcontrollers
#
config GIB_S5P64XX
        tristate "S5P64XX GIB Driver"
        depends on GIB && MACH_SMDK6450
        help
          Say Y here to include support for GIB controller in the
          Samsung S5P6450 based System-on-Chip devices.

endmenu # "GIB support"
```

## drivers/media/video/samsung/Kconfig
```kconfig
config VIDEO_SAMSUNG
	bool "Samsung Multimedia Devices"
	depends on VIDEO_CAPTURE_DRIVERS && VIDEO_V4L2
	select VIDEO_FIXED_MINOR_RANGES
	default n
	help
	  This is a representative video4linux configuration for Samsung multimedia devices.

if CPU_S5PV210
source "drivers/media/video/samsung/jpeg_v2/Kconfig"
endif


if VIDEO_SAMSUNG
comment "Reserved memory configurations"

config VIDEO_SAMSUNG_MEMSIZE_JPEG
	int "Memory size in kbytes for JPEG"
	depends on VIDEO_JPEG_V2 
	default "32768"

endif
```

## drivers/media/video/samsung/mfc50/Kconfig
```kconfig
#
# Configuration for Multi Format Codecs (MFC)
#

config VIDEO_MFC50
	bool "Samsung MFC (Multi Format Codec - FIMV 5.0) Driver"
	depends on VIDEO_SAMSUNG && CPU_S5PV210
	default n
	---help---
	  This is a Samsung Multi Format Codecs (MFC) FIMV V5.0 - driver for Samsung S5PV210

config VIDEO_MFC_MAX_INSTANCE
	int "Maximum size of MFC instance (1-4)"
	range 1 4
	depends on VIDEO_MFC50
	default 1

config VIDEO_MFC_MEM_PORT_COUNT
	int "Default number of MFC memory ports (1-2)"
	range 1 2
	depends on VIDEO_MFC50 && (!CPU_S5PV210_EVT0)
	default 2

config VIDEO_MFC_MEM_PORT_COUNT
	int
	depends on VIDEO_MFC50 && CPU_S5PV210_EVT0
	default 2

config VIDEO_MFC50_DEBUG
	bool "MFC driver debug message"
	depends on VIDEO_MFC50
	default n
```
